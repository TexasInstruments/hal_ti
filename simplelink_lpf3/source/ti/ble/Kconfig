## simplelink_lpf3/source/ti/ble/Kconfig
```kconfig
# Copyright (c) 2026 Texas Instruments Incorporated
# SPDX-License-Identifier: Apache-2.0

config BT_CTLR_TI_LEGACY_CMD
	bool "TI BLE Controller Legacy HCI Commands"
	default y
	help
	  Enable support for legacy HCI commands in the TI BLE controller
	  (e.g., HCI_LE_Set_Advertising_Parameters, HCI_LE_Set_Scan_Parameters).
	  Disable this option to reduce code size if legacy commands are not needed.

config BT_CTLR_TI_EXT_VS_CMD
	bool "TI BLE Controller Extended Vendor Specific Commands"
	default y if BT_HCI_RAW
	default n
	help
	  Enable support for extended vendor specific HCI commands in the
	  TI BLE controller. Disable this option to reduce code size if
	  extended vendor specific commands are not needed.

config BT_CTRL_TI_VS_RSSI_MONITOR
	bool "TI BLE Controller Vendor Specific RSSI Monitor"
	default n
	help
	  Enable the TI vendor-specific RSSI Monitor feature. Tracks received
	  signal strength per connection using a weighted average and invokes
	  registered callbacks when RSSI crosses configurable high/low thresholds
	  or returns to range.

config BT_TI_SWAT_TEST_MODE
	bool "TI BLE SWAT Test Mode (Internal TI Test Lab Only)"
	depends on BT_HCI_RAW
	default n
	help
	  Enable special test mode for TI SWAT (Software Automation Test) lab.
	  When enabled, vendor-specific LE meta events are NOT converted to
	  HCI Command Complete events, allowing direct testing of vendor-specific
	  event handling in the TI test lab.

	  This option should ONLY be enabled for internal TI testing and
	  validation purposes. It is NOT intended for production use or
	  customer applications.

	  Default: n (disabled)
```

## simplelink_lpf3/source/ti/drivers/rcl/Kconfig
```kconfig
# Copyright (c) 2026 Texas Instruments Incorporated
# SPDX-License-Identifier: Apache-2.0

config RCL_DRIVER
	bool "Radio Control Layer (RCL)"
	depends on HAS_CC23X0_SDK || HAS_CC27XX_SDK
	select ENTROPY_GENERATOR
	default n if MCUBOOT
	default y
	help
		Radio Control Layer (RCL) provides access to the radio hardware
		on LPF3 devices (CC23x0 and CC27xx).

		Disabled for MCUboot as it's not needed and causes configuration
		conflicts (enables MBEDTLS_CIPHER_AES_ENABLED which conflicts
		with MCUboot's crypto configuration).

		Say Y for wireless applications.

config RCL_RF_SETTING_PREGEN
	bool "Use pre-generated RF settings"
	depends on RCL_DRIVER
	default y
	help
		Use pre-generated RF/PHY settings created by SmartRF Studio or
		SysConfig. These contain optimized LRF register configurations
		for radio hardware tuned for specific protocols.

		Located at: ti/boards/generated/<board>/ti_radio_config.{c,h}

		Say Y to use board-specific pre-generated settings.
		Say N only if providing custom RF settings.

menu "Regulatory Domain Selection"
	depends on RCL_DRIVER
	depends on SOC_CC2755P10 || SOC_CC2755R10 || SOC_CC2745R10_Q1

config RCL_REGULATORY_DOMAIN_ETSI
	bool "ETSI: European Telecommunications Standards Institute (Europe)"
	default n

config RCL_REGULATORY_DOMAIN_FCC
	bool "FCC: Federal Communications Commission (USA)"
	default n

config RCL_REGULATORY_DOMAIN_MIIT
	bool "MIIT: Ministry of Information and Communications Technology (China)"
	default n

config RCL_REGULATORY_DOMAIN_RUNTIME_MODIFIABLE
	bool "Allow runtime modification of regulatory domain mask"
	default n

endmenu
```
